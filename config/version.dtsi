#define VERSION_MACRO
mac_ver: mac_ver {
compatible = "zmk,behavior-macro";
label = "mac_ver";
#binding-cells = <0>;
bindings = <&kp N2>, <&kp N0>, <&kp N2>, <&kp N5>, <&kp N0>, <&kp N2>, <&kp N0>, <&kp N7>, <&kp MINUS>, <&kp V>, <&kp N3>, <&kp DOT>, <&kp N0>, <&kp MINUS>, <&kp N8>, <&kp N8>, <&kp N8>, <&kp N2>, <&kp N7>, <&kp N0>, <&kp N5>, <&kp RET>;
};
